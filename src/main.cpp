// M5Stack Tab5: IMU (BMI270) visualizer + MQTT streamer.
//
// Tasks:  gfx (core 0)  - draws from a locked snapshot of the latest data
//         sample (core 1) - 100 Hz IMU read, orientation filter, writes shared state
//         power (core 1)  - 10 Hz battery V/I/P (INA226), temperatures, RSSI, mic level
//         mqtt (core 1)   - owns WiFi + MQTT, publishes imu 50 Hz (tab5/imu) + power 10 Hz (tab5/power)
//
// Display (portrait 720x1280 = the panel's native orientation; landscape costs ~15x in pushSprite).
// Rendering: STRIP_H-px strips drawn into a small internal-RAM sprite (10x faster than PSRAM) and pushed
// one by one, instead of one full-screen PSRAM sprite:
//   g-force scope (accel x/y ball + trail, z bar), gyro rate dials, linear-accel history.
#include <M5Unified.h>
#include <WiFi.h>
#include <WiFiClientSecure.h>
#include <PubSubClient.h>
#include <math.h>
#include <time.h>
#include <esp_heap_caps.h>
#include <esp_system.h>
#include "secrets.h"
#include "mqtt_creds.h"   // generated by broker/setup-tls.sh
#include "ca_cert.h"      // generated by broker/setup-tls.sh

static constexpr int   HIST        = 300;     // history samples (3 s at 100 Hz)
static constexpr int   PHIST       = 300;     // power history (30 s at 10 Hz)
static constexpr float PWR_RANGE_W = 15.0f;   // power chart range, +/- W
static constexpr float BAT_WH      = 14.8f;   // NP-F550 pack: 2000 mAh x 7.4 V. Change if you fit another battery.
static constexpr float ETA_MIN_W   = 0.3f;    // below this average power there is nothing meaningful to estimate
static constexpr int   TRAIL       = 50;      // scope trail length
static constexpr float SCOPE_G     = 2.0f;    // scope edge = +/-2 g
static constexpr float GYR_RANGE_D = 500.0f;  // dial full scale, dps
static constexpr float LIN_RANGE_G = 1.0f;    // linear-accel chart range
#ifndef STRIP_H_PX
#define STRIP_H_PX 80    // 160 px took 230 kB of internal RAM, leaving TLS too little to reconnect
#endif
static constexpr int   SCR_W = 720, SCR_H = 1280, STRIP_H = STRIP_H_PX;   // SCR_H / STRIP_H strips

// Link recovery. The esp-hosted link to the C6 can wedge, and TLS then cannot get enough internal RAM to
// reconnect. Escalate: reset Wi-Fi after a few failed connects, restart the chip if still offline after
// OFFLINE_RESTART_MS or if the tx task stops running for TX_HANG_MS. Give up restarting after MAX_WD_RESTARTS in
// a row without a connection so a dead broker cannot cause a reboot loop.
static constexpr uint32_t OFFLINE_RESTART_MS = 180000;
static constexpr uint32_t TX_HANG_MS         = 60000;
static constexpr int      WIFI_RESET_EVERY   = 3;      // failed MQTT connects
static constexpr uint32_t MAX_WD_RESTARTS    = 3;
static constexpr uint32_t WD_MAGIC           = 0xA5C0FFEE;
RTC_NOINIT_ATTR static uint32_t wdMagic, wdRestarts;
static volatile uint32_t txBeat;      // txTask heartbeat (millis)
static volatile int      gfxFps;      // for the memory log line

static void memLine(const char *tag) {
  Serial.printf("%s: internal free=%u largest=%u min=%u fps=%d\n", tag,
                (unsigned)heap_caps_get_free_size(MALLOC_CAP_INTERNAL),
                (unsigned)heap_caps_get_largest_free_block(MALLOC_CAP_INTERNAL),
                (unsigned)heap_caps_get_minimum_free_size(MALLOC_CAP_INTERNAL), (int)gfxFps);
}

static void recoveryRestart(const char *why) {
  if (wdRestarts >= MAX_WD_RESTARTS) return;           // already tried; keep retrying in place
  wdRestarts++;
  Serial.printf("RECOVERY restart %u/%u: %s\n", (unsigned)wdRestarts, (unsigned)MAX_WD_RESTARTS, why);
  memLine("RECOVERY mem");
  Serial.flush();
  delay(100);
  ESP.restart();
}
static constexpr BaseType_t CORE_GFX = 0, CORE_IO = 1;

static void sampleTask(void *);
static void txTask(void *);
static void powerTask(void *);
static void micTask(void *);
static void drawTask(void *);

// ---------- shared state ----------
// Everything gfx needs lives in one struct. sampleTask updates it under `mtx`;
// drawTask copies it under `mtx` and then draws from its private copy, so a frame
// never sees a half-updated sample or history ring.
// One reading of the power/environment sensors (powerTask -> gfx and -> MQTT).
struct PowerS {
  uint32_t t;        // millis()
  float v, i, p;     // battery V, A (+ = charging), W (+ = charging)
  float soc;         // %, from pack voltage
  int   chg;         // 1 charging, 0 idle/full, -1 discharging
  float tImu, tChip; // degC (BMI270, ESP32-P4 die)
  int   rssi;        // dBm, 0 = not connected
  uint32_t heap;     // free internal heap, bytes
  float mic;         // dBFS of the internal mic, -99 = mic off
  float avg;         // ~10 s average of p, W (+ charging)
  float wh;          // energy stored in the pack, Wh (capacity x charge %)
  float eta;         // minutes to empty (avg < 0) or to full (avg > 0); -1 = not meaningful
  int   bri, scr;    // screen brightness 0..255 and on/off, so the viewer can show them
};

static constexpr int MIC_N = 512, MIC_RATE = 16000;   // 32 ms blocks, 16-bit mono -> 32 kB/s
struct AudioChunk { int16_t pcm[MIC_N]; };

struct Snap {
  float a[3];                 // accel, g (raw, includes gravity)
  float g[3];                 // gyro, dps
  float roll, pitch, yaw;     // degrees
  int   head;                 // next write index into the rings
  float accHist[3][HIST];     // raw accel history
  float linHist[3][HIST];     // accel with gravity removed
  PowerS pw;                  // latest power reading
  float pHist[PHIST];         // battery power history, W
  int   pHead;
};
static Snap live;
static SemaphoreHandle_t mtx;

// Single-writer status flags (aligned 32-bit, so reads/writes are atomic on this core).
static volatile bool     wifiUp, mqttUp;
static volatile uint32_t pubRate;
static volatile uint32_t pubTotal;                 // every message published (all topics): drives the activity dot
static volatile uint32_t wifiDownSince, mqttDownSince;   // millis() when the link went down, 0 = up (mqtt: counted while Wi-Fi is up)

struct Sample { uint32_t t; float ax, ay, az, gx, gy, gz, roll, pitch, yaw; };
static QueueHandle_t sampleQ;   // sampleTask -> txTask
static QueueHandle_t powerQ;    // powerTask  -> txTask
static QueueHandle_t audioQ;    // micTask    -> txTask
static volatile bool  micWant;  // set by the MQTT command (txTask), read by micTask
static volatile bool  micOn;    // micTask's actual state
static volatile float micLevel = -99;   // dBFS, written by micTask
// Screen control: the MQTT callback only sets the *Want flags; drawTask owns the display and applies them.
static volatile int     briWant = -1;      // pending brightness 0..255
static volatile int     scrWant = -1;      // pending screen state: 1 on, 0 off
static volatile uint8_t briLevel = 128;    // brightness used while the screen is on
static volatile bool    scrOn = true;
static SemaphoreHandle_t i2cMtx; // IMU and INA226 share the internal I2C bus

static M5Canvas canvas(&M5.Display);               // one STRIP_H-high strip, internal RAM

// Draw target for the current strip: forwards to `canvas` with y shifted by -oy, and skips
// primitives that lie entirely outside the strip. All drawing code is written in screen coordinates.
struct Gx {
  int oy = 0;
  bool out(int y0, int y1) const { return y1 < oy || y0 >= oy + STRIP_H; }
  void fillRect(int x, int y, int w, int h, uint16_t c) { if (!out(y, y + h)) canvas.fillRect(x, y - oy, w, h, c); }
  void drawRect(int x, int y, int w, int h, uint16_t c) { if (!out(y, y + h)) canvas.drawRect(x, y - oy, w, h, c); }
  void fillRoundRect(int x, int y, int w, int h, int r, uint16_t c) { if (!out(y, y + h)) canvas.fillRoundRect(x, y - oy, w, h, r, c); }
  void drawFastHLine(int x, int y, int w, uint16_t c) { if (!out(y, y)) canvas.drawFastHLine(x, y - oy, w, c); }
  void drawFastVLine(int x, int y, int h, uint16_t c) { if (!out(y, y + h)) canvas.drawFastVLine(x, y - oy, h, c); }
  void drawLine(int x0, int y0, int x1, int y1, uint16_t c) {
    if (out(y0 < y1 ? y0 : y1, y0 < y1 ? y1 : y0)) return;
    canvas.drawLine(x0, y0 - oy, x1, y1 - oy, c);
  }
  void drawCircle(int x, int y, int r, uint16_t c) { if (!out(y - r, y + r)) canvas.drawCircle(x, y - oy, r, c); }
  void fillCircle(int x, int y, int r, uint16_t c) { if (!out(y - r, y + r)) canvas.fillCircle(x, y - oy, r, c); }
  void drawArc(int x, int y, int r0, int r1, float a0, float a1, uint16_t c) { int R = r0 > r1 ? r0 : r1; if (!out(y - R, y + R)) canvas.drawArc(x, y - oy, r0, r1, a0, a1, c); }
  void fillArc(int x, int y, int r0, int r1, float a0, float a1, uint16_t c) { int R = r0 > r1 ? r0 : r1; if (!out(y - R, y + R)) canvas.fillArc(x, y - oy, r0, r1, a0, a1, c); }
  void drawString(const char *t, int x, int y) { if (!out(y, y + 8 * textSize)) canvas.drawString(t, x, y - oy); }
  void drawCenterString(const char *t, int x, int y) { if (!out(y, y + 8 * textSize)) canvas.drawCenterString(t, x, y - oy); }
  void setTextSize(int sz) { textSize = sz; canvas.setTextSize(sz); }
  void setTextColor(uint16_t c) { canvas.setTextColor(c); }
  uint16_t color565(int r, int gr, int b) { return canvas.color565(r, gr, b); }
  int width() const { return SCR_W; }
  int textSize = 1;
};
static Gx g;
static WiFiClientSecure wifiClient;   // TLS, server cert verified against the pinned CA
static PubSubClient mqtt(wifiClient);

// Colours (RGB565). Black bg lets fillSprite use the fast memset path.
static const uint16_t C_BG = 0x0000, C_PANEL = 0x10A2, C_GRID = 0x39E7, C_TXT = 0xFFFF, C_DIM = 0x8C71;
static const uint16_t C_X = 0xF9A6, C_Y = 0x5FEA, C_Z = 0x5D7F;
static const uint16_t AXC[3] = {C_X, C_Y, C_Z};

// ---------- sampling-side maths (sampleTask only) ----------
static void orientation(float ax, float ay, float az, float gx, float gy, float gz, float dt,
                        float &roll, float &pitch, float &yaw) {
  float accRoll  = atan2f(ay, az);
  float accPitch = atan2f(-ax, sqrtf(ay * ay + az * az));
  const float a = 0.98f;
  roll  = a * (roll  + gx * DEG_TO_RAD * dt) + (1 - a) * accRoll;
  pitch = a * (pitch + gy * DEG_TO_RAD * dt) + (1 - a) * accPitch;
  yaw  += gz * DEG_TO_RAD * dt;               // no magnetometer: yaw drifts
  if (yaw >  M_PI) yaw -= 2 * M_PI;
  if (yaw < -M_PI) yaw += 2 * M_PI;
}

// ---------- drawing (drawTask only; reads only its private snapshot) ----------
static void panel(int y, int h) { g.fillRoundRect(12, y, g.width() - 24, h, 8, C_PANEL); }

static void drawScope(const Snap &s, int y0, int h) {
  panel(y0, h);
  const int cx = 300, cy = y0 + 255, R = 170;
  g.setTextSize(2); g.setTextColor(C_TXT);
  g.drawString("ACCEL  g-force scope", 28, y0 + 12);

  float mag = sqrtf(s.a[0] * s.a[0] + s.a[1] * s.a[1] + s.a[2] * s.a[2]);
  char b[48];
  g.setTextSize(4); g.setTextColor(mag > 1.5f ? C_X : C_TXT);
  snprintf(b, sizeof b, "%.2f g", mag);
  g.drawString(b, 28, y0 + 44);

  // grid: rings every 0.5 g, crosshair
  for (int i = 1; i <= 4; i++) g.drawCircle(cx, cy, R * i / 4, i == 2 ? C_DIM : C_GRID);
  g.drawFastHLine(cx - R, cy, 2 * R, C_GRID);
  g.drawFastVLine(cx, cy - R, 2 * R, C_GRID);
  g.setTextSize(1); g.setTextColor(C_DIM);
  g.drawString("1g", cx + R / 2 + 3, cy + 3);
  g.drawString("2g", cx + R + 3, cy + 3);

  auto pos = [&](int idx, int &px, int &py) {
    float x = s.accHist[0][idx], y = s.accHist[1][idx];
    float m = sqrtf(x * x + y * y);
    if (m > SCOPE_G) { x *= SCOPE_G / m; y *= SCOPE_G / m; }
    px = cx + (int)(x / SCOPE_G * R);
    py = cy - (int)(y / SCOPE_G * R);
  };

  // fading trail, oldest -> newest
  for (int i = 0; i < TRAIL; i++) {
    int idx = (s.head - TRAIL + i + 2 * HIST) % HIST;
    int px, py; pos(idx, px, py);
    int k = 40 + (i * 215) / TRAIL;                           // 40..255
    g.fillCircle(px, py, 3 + i * 8 / TRAIL, g.color565(0, k * 3 / 4, k));
  }
  int bx, by; pos((s.head - 1 + HIST) % HIST, bx, by);
  for (int w = -1; w <= 1; w++) g.drawLine(cx + w, cy, bx + w, by, C_DIM);
  g.fillCircle(bx, by, 17, C_Y);
  g.drawCircle(bx, by, 18, C_TXT);

  // Z bar (+/-2 g)
  const int zx = 640, zw = 28, zt = cy - R, zh = 2 * R;
  g.drawRect(zx, zt, zw, zh, C_GRID);
  g.drawFastHLine(zx - 4, cy, zw + 8, C_DIM);
  float z = fmaxf(-SCOPE_G, fminf(SCOPE_G, s.a[2]));
  int zl = (int)(fabsf(z) / SCOPE_G * R);
  if (z >= 0) g.fillRect(zx + 2, cy - zl, zw - 4, zl, C_Z);
  else        g.fillRect(zx + 2, cy,      zw - 4, zl, C_Z);
  g.setTextSize(2); g.setTextColor(C_Z); g.drawString("Z", zx + 6, zt - 24);

  // numbers
  g.setTextSize(2);
  for (int a = 0; a < 3; a++) {
    g.setTextColor(AXC[a]);
    snprintf(b, sizeof b, "%c %+5.2f", "XYZ"[a], s.a[a]);
    g.drawString(b, 28 + a * 220, y0 + h - 36);
  }
}

static void drawDials(const Snap &s, int y0, int h) {
  panel(y0, h);
  g.setTextSize(2); g.setTextColor(C_TXT);
  g.drawString("GYRO  rate dps", 28, y0 + 12);
  const int R = 88, cy = y0 + 140;
  for (int a = 0; a < 3; a++) {
    int cx = 128 + a * 232;
    float v = fmaxf(-GYR_RANGE_D, fminf(GYR_RANGE_D, s.g[a]));
    float sweep = v / GYR_RANGE_D * 135.0f;                    // deg, clockwise positive
    g.drawArc(cx, cy, R, R - 2, 135, 405, C_GRID);         // scale: 270 deg, gap at the bottom
    if (sweep >= 0) g.fillArc(cx, cy, R - 4, R - 20, 270, 270 + sweep, AXC[a]);
    else            g.fillArc(cx, cy, R - 4, R - 20, 270 + sweep, 270, AXC[a]);
    float th = (270.0f + sweep) * DEG_TO_RAD;
    int nx = cx + (int)((R - 24) * cosf(th)), ny = cy + (int)((R - 24) * sinf(th));
    for (int w = -1; w <= 1; w++) g.drawLine(cx + w, cy, nx + w, ny, C_TXT);
    g.fillCircle(cx, cy, 6, C_TXT);
    g.setTextColor(AXC[a]); g.setTextSize(3);
    char b[24]; snprintf(b, sizeof b, "%c", "XYZ"[a]);
    g.drawCenterString(b, cx, cy + 22);
    g.setTextSize(2); g.setTextColor(C_TXT);
    snprintf(b, sizeof b, "%+.0f", s.g[a]);
    g.drawCenterString(b, cx, cy + 56);
  }
}

static void drawLinear(const Snap &s, int y0, int h) {
  panel(y0, h);
  g.setTextSize(2); g.setTextColor(C_TXT);
  g.drawString("LINEAR ACCEL  (gravity removed)", 28, y0 + 12);
  char b[24];
  const int px = 24, pw = g.width() - 48, py = y0 + 76, ph = h - 92;
  for (int a = 0; a < 3; a++) {
    g.setTextColor(AXC[a]);
    int i = (s.head - 1 + HIST) % HIST;
    snprintf(b, sizeof b, "%c %+5.2f", "XYZ"[a], s.linHist[a][i]);
    g.drawString(b, 28 + a * 220, y0 + 44);
  }
  g.drawRect(px, py, pw, ph, C_GRID);
  g.drawFastHLine(px, py + ph / 2, pw, C_GRID);
  g.setTextSize(1); g.setTextColor(C_DIM);
  g.drawString("+1g", px + 4, py + 3);
  g.drawString("-1g", px + 4, py + ph - 12);
  for (int a = 0; a < 3; a++) {
    int ppx = 0, ppy = 0;
    for (int i = 0; i < HIST; i += 2) {                         // decimate: half the line draws
      float v = fmaxf(-LIN_RANGE_G, fminf(LIN_RANGE_G, s.linHist[a][(s.head + i) % HIST]));
      int sx = px + i * (pw - 1) / (HIST - 1);
      int sy = py + ph / 2 - (int)(v / LIN_RANGE_G * (ph / 2 - 2));
      if (i) { g.drawLine(ppx, ppy, sx, sy, AXC[a]); g.drawLine(ppx, ppy + 1, sx, sy + 1, AXC[a]); }
      ppx = sx; ppy = sy;
    }
  }
}

// "3h 12m", "45m", "99+h"
static void fmtEta(char *o, size_t n, float min) {
  if (min < 0) snprintf(o, n, "--");
  else if (min < 1) snprintf(o, n, "<1m");
  else if (min < 60) snprintf(o, n, "%.0fm", min);
  else if (min < 6000) snprintf(o, n, "%dh %02dm", (int)(min / 60), (int)fmodf(min, 60.0f));
  else snprintf(o, n, "99+h");
}

static void drawPower(const Snap &s, int y0, int h) {
  panel(y0, h);
  const PowerS &p = s.pw;
  char b[64];
  g.setTextSize(2); g.setTextColor(C_TXT);
  g.drawString("POWER  battery (2S pack)", 28, y0 + 12);
  const char *st = p.chg > 0 ? "CHARGING" : p.chg < 0 ? "DISCHARGING" : "IDLE";
  g.setTextColor(p.chg > 0 ? C_Y : p.chg < 0 ? C_X : C_DIM);
  g.drawString(st, 440, y0 + 12);

  g.setTextSize(4);                                      // magnitudes only; the state label carries the direction
  uint16_t sc = p.chg > 0 ? C_Y : p.chg < 0 ? C_X : C_DIM;
  g.setTextColor(C_Z);   snprintf(b, sizeof b, "%.2fV", p.v);            g.drawString(b, 28, y0 + 40);
  g.setTextColor(C_TXT); snprintf(b, sizeof b, "%.2fA", fabsf(p.i));     g.drawString(b, 250, y0 + 40);
  g.setTextColor(sc);    snprintf(b, sizeof b, "%.2fW", fabsf(p.p));     g.drawString(b, 470, y0 + 40);

  g.setTextSize(2); g.setTextColor(C_DIM);
  char eta[16]; fmtEta(eta, sizeof eta, p.eta);
  char rs[16];  if (p.rssi) snprintf(rs, sizeof rs, "%d dBm", p.rssi); else snprintf(rs, sizeof rs, "no signal");
  if (p.eta < 0)  snprintf(b, sizeof b, "%.0f%%  %.1f Wh stored  no drain to estimate", p.soc, p.wh);
  else            snprintf(b, sizeof b, "%.0f%%  %.1f Wh  %s %s at %.1f W avg", p.soc, p.wh,
                           p.avg < 0 ? "left" : "to full", eta, fabsf(p.avg));
  g.drawString(b, 28, y0 + 84);
  if (micOn) snprintf(b, sizeof b, "MIC LIVE %.0f dBFS  %s  heap %uk", p.mic, rs, (unsigned)(p.heap / 1024));
  else       snprintf(b, sizeof b, "IMU %.1fC  chip %.0fC  %s  heap %uk", p.tImu, p.tChip, rs, (unsigned)(p.heap / 1024));
  g.setTextColor(micOn ? C_X : C_DIM);
  g.drawString(b, 28, y0 + 108);

  // 30 s power history, +/-PWR_RANGE_W
  const int px = 24, pw = g.width() - 48, py = y0 + 136, ph = h - 148;
  g.drawRect(px, py, pw, ph, C_GRID);
  g.drawFastHLine(px, py + ph / 2, pw, C_GRID);
  g.setTextSize(1); g.setTextColor(C_DIM);
  g.drawString("charging", px + 4, py + 3);
  g.drawString("discharging", px + 4, py + ph - 12);
  int ppx = 0, ppy = 0;
  for (int i = 0; i < PHIST; i += 2) {
    float v = fmaxf(-PWR_RANGE_W, fminf(PWR_RANGE_W, s.pHist[(s.pHead + i) % PHIST]));
    int sx = px + i * (pw - 1) / (PHIST - 1);
    int sy = py + ph / 2 - (int)(v / PWR_RANGE_W * (ph / 2 - 2));
    if (i) { g.drawLine(ppx, ppy, sx, sy, C_Y); g.drawLine(ppx, ppy + 1, sx, sy + 1, C_Y); }
    ppx = sx; ppy = sy;
  }
}

// Status glyphs, shared by the header and the quick-settings panel.
// Wi-Fi: three arcs and a dot. Connected: lit arcs and colour follow the signal (>= -60 dBm 3 green, >= -70 2 green,
// >= -80 1 amber, weaker 1 red; rssi 0 = reading unavailable, shown as plain connected). Not connected: the arcs sweep
// in amber while it is (re)joining; after 30 s down they sweep in red with a slash.
static const uint32_t LINK_GRACE_MS = 30000;
static uint16_t amber() { return g.color565(255, 176, 32); }

static void drawWifiGlyph(int wx, int wy, int base, int step, int thick, int dot, int rs) {
  const uint32_t now = millis();
  int lit; uint16_t c; bool slash = false;
  if (wifiUp) {
    if (rs == 0 || rs >= -60) { lit = 3; c = C_Y; }
    else if (rs >= -70)       { lit = 2; c = C_Y; }
    else if (rs >= -80)       { lit = 1; c = amber(); }
    else                      { lit = 1; c = C_X; }
  } else {
    slash = now - wifiDownSince > LINK_GRACE_MS;      // wifiDownSince 0 at boot: counts from power-up
    c = slash ? C_X : amber();
    lit = (int)((now / 250) % 4);                     // 0..3 arcs, repeating
  }
  for (int k = 0; k < 3; k++) g.drawArc(wx, wy, base + step * k, base + step * k + thick, 225, 315, k < lit ? c : (uint16_t)C_GRID);
  g.fillCircle(wx, wy, dot, c);
  if (slash) {
    const int R = base + 2 * step + thick;
    g.drawLine(wx - R * 8 / 10, wy - R * 115 / 100, wx + R * 8 / 10, wy + 4, c);
    g.drawLine(wx - R * 8 / 10 + 1, wy - R * 115 / 100, wx + R * 8 / 10 + 1, wy + 4, c);
  }
}

// Activity: true while messages are going out; flickers (toggles every 8 messages) so you can see data moving.
static bool pubFlicker() {
  static uint32_t seen, seenAt;
  const uint32_t now = millis(), t = pubTotal;
  if (t != seen) { seen = t; seenAt = now; }
  return now - seenAt < 300 && ((t >> 3) & 1);
}

// Broker: a two-unit server. Connected: green, the lower dot flickers with traffic. Connecting (Wi-Fi up, broker not):
// amber, the two dots blink in turn; after 30 s red with a slash. Wi-Fi down: red, slashed, still.
// (x, y) is the top-left corner; holeColor is the colour of an unlit dot.
static void drawBrokerGlyph(int x, int y, int w, int h, int pitch, int dot, uint16_t holeColor) {
  const uint32_t now = millis();
  uint16_t c; bool slash = false; int blink = -1;       // blink: which dot is lit, -1 none
  if (mqttUp)       { c = C_Y; blink = pubFlicker() ? 1 : -1; }
  else if (!wifiUp) { c = C_X; slash = true; }
  else {
    slash = mqttDownSince && now - mqttDownSince > LINK_GRACE_MS;
    c = slash ? C_X : amber();
    blink = (int)((now / 250) & 1);
  }
  for (int k = 0; k < 2; k++) {
    g.fillRoundRect(x, y + pitch * k, w, h, h / 4, c);
    g.fillCircle(x + w * 4 / 5, y + pitch * k + h / 2, dot, k == blink ? (uint16_t)C_TXT : holeColor);
  }
  if (slash) {
    g.drawLine(x - 2, y - 2, x + w + 2, y + pitch + h + 2, C_TXT);
    g.drawLine(x - 1, y - 2, x + w + 3, y + pitch + h + 2, C_TXT);
  }
}

static void drawHeader(int fps, int rssi) {
  g.fillRect(0, 0, SCR_W, 76, C_PANEL);
  g.setTextSize(3); g.setTextColor(C_TXT);
  g.drawString("Tab5 IMU", 16, 10);
  g.setTextSize(2);
  drawWifiGlyph(262, 32, 4, 4, 2, 2, rssi);              // all within y 14..35, clear of the text line at y 46
  drawBrokerGlyph(304, 14, 24, 9, 12, 1, C_PANEL);
  g.setTextColor(C_DIM);
  char b[64];
  snprintf(b, sizeof b, "%u msg/s", (unsigned)pubRate);
  g.drawString(b, 16, 46);
  // ">>>" drawn as three chevrons that light up in turn while the broker link is up (red and still when it is down).
  // 5 steps of 160 ms: 0..2 one chevron bright with a dimmer trail behind it, 3 the last trail, 4 rest.
  int x = 16 + (int)strlen(b) * 12 + 12;
  const int ph = mqttUp ? (int)((millis() / 160) % 5) : -1;
  const uint16_t mid = g.color565(45, 120, 110);
  for (int k = 0; k < 3; k++) {
    const uint16_t c = !mqttUp ? C_X : ph == k ? C_Y : ph == k + 1 ? mid : (uint16_t)C_GRID;
    const int cx = x + 14 * k, cy = 54;
    for (int t = 0; t < 2; t++) {                               // two lines wide
      g.drawLine(cx + t, cy - 8, cx + 7 + t, cy, c);
      g.drawLine(cx + 7 + t, cy, cx + t, cy + 8, c);
    }
  }
  x += 3 * 14 + 8;
  snprintf(b, sizeof b, "%s:%d", MQTT_HOST, MQTT_PORT);
  g.drawString(b, x, 46);
  snprintf(b, sizeof b, "%d fps", fps);
  g.drawString(b, SCR_W - 100, 14);
  if (micOn) { g.fillCircle(SCR_W - 60, 56, 9, C_X); g.setTextColor(C_X); g.drawString("MIC", SCR_W - 44, 48); }
}

// ---------- touch + quick settings (drawTask only) ----------
// Swipe down from the top edge to pull the panel down: brightness slider and a Screen off tile. With the screen
// off, any touch wakes it (and that touch is swallowed). The library's flick detection is unreliable, so the pull
// gesture is tracked by hand: a touch that starts in the top EDGE_PX and moves down PULL_PX opens the panel.
static uint8_t backlightDuty(uint8_t lvl);
static constexpr int EDGE_PX = 40, PULL_PX = 150, MENU_H = 380;
static constexpr int SL_X0 = 120, SL_X1 = 600, SL_Y = 150;                 // slider track, panel coordinates
static constexpr int T_X0 = 24, T_Y0 = 214, T_W = 150, T_H = 120, T_GAP = 24;      // four icon tiles per row
static bool  menuOpen, trackPull, swallow, dragSlider;
static float menuP;                                                       // 0 closed .. 1 fully open
static int   pullY0, lastX, lastY, downY;
// While the panel is up the dashboard is frozen: it is drawn once, dimmed, and the strips under the panel are kept
// here (PSRAM). Sliding then only copies those strips back and draws the panel; closing redraws the live dashboard.
static constexpr int CACHE_STRIPS = (MENU_H + STRIP_H - 1) / STRIP_H;
static uint16_t *bgCache;
static bool     bgReady, menuDirty;
static uint32_t menuTick;
static void menuClose() { menuOpen = false; menuP = 0; bgReady = false; }

static int   levelPct(int lvl) { return (lvl * 100 + 127) / 255; }
static float levelFrac(int lvl) { float f = (levelPct(lvl) - 5) / 95.0f; return f < 0 ? 0 : f > 1 ? 1 : f; }

static void screenSet(bool on) {
  scrOn = on;
  M5.Display.setBrightness(on ? backlightDuty(briLevel) : 0);
  if (!on) menuClose();
}

static void sliderTo(int x) {
  float f = (float)(x - SL_X0) / (SL_X1 - SL_X0);
  f = f < 0 ? 0 : f > 1 ? 1 : f;
  int lvl = (int)(255.0f * (5.0f + 95.0f * f) / 100.0f + 0.5f);
  if (lvl == (int)briLevel) return;
  briLevel = lvl;
  M5.Display.setBrightness(backlightDuty(briLevel));
  menuDirty = true;
}

static void pollTouch() {
  static uint32_t last;
  uint32_t now = millis();
  if (now - last < 20) return;                       // 50 Hz at most
  last = now;
  xSemaphoreTake(i2cMtx, portMAX_DELAY);             // touch shares the internal I2C bus with the IMU and INA226
  M5.update();
  xSemaphoreGive(i2cMtx);
  auto t = M5.Touch.getDetail();
  if (swallow) { if (!t.isPressed()) swallow = false; return; }
  if (!scrOn) {
    if (t.wasPressed()) { screenSet(true); swallow = true; Serial.println("touch: woke the screen"); }
    return;
  }
  if (!menuOpen) {
    if (t.wasPressed()) { trackPull = t.y < EDGE_PX; pullY0 = t.y; }
    else if (trackPull && t.isPressed() && t.y - pullY0 > PULL_PX) {
      if (!bgCache) { Serial.println("touch: no cache memory, panel disabled"); trackPull = false; return; }
      menuOpen = true; menuP = 0; bgReady = false; menuDirty = true; trackPull = false; swallow = true;
      Serial.println("touch: quick settings opened");
    }
    if (!t.isPressed()) trackPull = false;
    return;
  }
  if (menuP < 1.0f) return;                          // still sliding in
  if (t.isPressed()) { lastX = t.x; lastY = t.y; }
  if (t.wasPressed()) {
    downY = t.y;
    dragSlider = t.y > SL_Y - 45 && t.y < SL_Y + 45 && t.x > SL_X0 - 30 && t.x < SL_X1 + 30;
    if (dragSlider) sliderTo(t.x);
  } else if (t.isPressed() && dragSlider) {
    sliderTo(t.x);
  } else if (t.wasReleased()) {
    if (!dragSlider) {
      if (downY - lastY > 80) { menuClose(); }                                               // swipe up
      else if (lastX >= T_X0 && lastX < T_X0 + T_W && lastY >= T_Y0 && lastY < T_Y0 + T_H) { // Screen off tile
        screenSet(false); swallow = true; Serial.println("touch: screen off");
      } else if (lastY > MENU_H) { menuClose(); }                                            // tap outside
    } else {
      Serial.printf("touch: brightness %d%%\n", levelPct(briLevel));
    }
    dragSlider = false;
  }
}

static void drawMenu(const Snap &s) {
  const int off = (int)((menuP - 1.0f) * MENU_H);                     // slides down from above the screen
  const uint16_t cShade = g.color565(23, 28, 35), cTile = g.color565(35, 43, 53), cKnob = g.color565(91, 140, 255);
  g.fillRoundRect(0, off - 24, SCR_W, MENU_H + 24, 22, cShade);
  g.setTextSize(3); g.setTextColor(C_TXT);
  g.drawString("Quick settings", 28, off + 26);
  const PowerS &p = s.pw;
  char b[64];
  snprintf(b, sizeof b, "%.0f%%  %s  %.1f W", p.soc, p.chg > 0 ? "charging" : p.chg < 0 ? "discharging" : "idle", fabsf(p.avg));
  g.setTextSize(2); g.setTextColor(C_DIM);
  g.drawString(b, 28, off + 70);

  // brightness: sun icon, track, knob, percentage
  const int cy = off + SL_Y, sx = SL_X0 + (int)(levelFrac(briLevel) * (SL_X1 - SL_X0));
  g.drawCircle(64, cy, 9, C_TXT); g.drawCircle(64, cy, 10, C_TXT);
  for (int k = 0; k < 8; k++) {
    float a = k * (float)M_PI / 4;
    g.drawLine(64 + (int)(16 * cosf(a)), cy + (int)(16 * sinf(a)), 64 + (int)(23 * cosf(a)), cy + (int)(23 * sinf(a)), C_TXT);
  }
  g.fillRoundRect(SL_X0, cy - 5, SL_X1 - SL_X0, 10, 5, C_GRID);
  g.fillRoundRect(SL_X0, cy - 5, sx - SL_X0, 10, 5, cKnob);
  g.fillCircle(sx, cy, 22, C_TXT);
  snprintf(b, sizeof b, "%d%%", levelPct(briLevel));
  g.setTextSize(2); g.setTextColor(C_TXT);
  g.drawString(b, 626, cy - 8);

  // tiles: icons only. 1 = Screen off (a button), 2 = Wi-Fi and 3 = broker (status, green when up, red with a slash when down)
  const int ty = off + T_Y0, cTile2 = g.color565(27, 34, 42);
  const int x1 = T_X0, x2 = T_X0 + (T_W + T_GAP), x3 = T_X0 + 2 * (T_W + T_GAP);
  g.fillRoundRect(x1, ty, T_W, T_H, 18, cTile);
  g.fillRoundRect(x2, ty, T_W, T_H, 18, cTile2);
  g.fillRoundRect(x3, ty, T_W, T_H, 18, cTile2);

  // power symbol
  { const int ix = x1 + T_W / 2, iy = ty + T_H / 2 + 6;
    g.drawCircle(ix, iy, 24, C_TXT); g.drawCircle(ix, iy, 25, C_TXT); g.drawCircle(ix, iy, 26, C_TXT);
    g.fillRect(ix - 12, iy - 34, 24, 24, cTile);                 // gap in the ring
    g.fillRoundRect(ix - 2, iy - 36, 5, 30, 2, C_TXT); }

  drawWifiGlyph(x2 + T_W / 2, ty + 88, 14, 12, 4, 5, p.rssi);
  drawBrokerGlyph(x3 + T_W / 2 - 30, ty + 32, 60, 22, 30, 4, cTile2);

  g.fillRoundRect(SCR_W / 2 - 40, off + MENU_H - 24, 80, 8, 4, C_DIM);
}

// Panel frames: restore the cached, dimmed dashboard under the panel, draw the panel, push only those strips.
static void drawMenuFrame(const Snap &s) {
  const int bottom = (int)((menuP - 1.0f) * MENU_H) + MENU_H;
  for (int i = 0; i < CACHE_STRIPS && i * STRIP_H < bottom; i++) {
    pollTouch();
    if (!menuOpen) return;                                 // closed meanwhile: the next frame redraws everything
    g.oy = i * STRIP_H;
    memcpy(canvas.getBuffer(), bgCache + (size_t)i * SCR_W * STRIP_H, (size_t)SCR_W * STRIP_H * 2);
    drawMenu(s);
    canvas.pushSprite(0, g.oy);
  }
}

// Opening the panel: do not re-render the dashboard. Read the picture that is already on the screen back from the
// panel framebuffer, halve every pixel's brightness (RGB565: shift right one and mask the bits that crossed fields,
// two pixels per 32-bit word), keep the strips the panel will cover, and push them all back.
static void freezeDashboard() {
  uint32_t t0 = millis();
  const size_t words = (size_t)SCR_W * STRIP_H / 2, bytes = (size_t)SCR_W * STRIP_H * 2;
  for (int i = 0; i < SCR_H / STRIP_H; i++) {
    const int y = i * STRIP_H;
    M5.Display.readRect(0, y, SCR_W, STRIP_H, (lgfx::rgb565_t *)canvas.getBuffer());
    uint32_t *w = (uint32_t *)canvas.getBuffer();
    for (size_t k = 0; k < words; k++) w[k] = (w[k] >> 1) & 0x7BEF7BEFu;
    if (i < CACHE_STRIPS) memcpy(bgCache + (size_t)i * SCR_W * STRIP_H, canvas.getBuffer(), bytes);
    canvas.pushSprite(0, y);
  }
  bgReady = true;
  Serial.printf("panel: dashboard frozen in %u ms\n", (unsigned)(millis() - t0));
}

static void draw(const Snap &s, int fps) {
  const int gap = 8, y1 = 84, h1 = 500;
  const int y2 = y1 + h1 + gap, h2 = 232;
  const int y3 = y2 + h2 + gap, h3 = 200;
  const int y4 = y3 + h3 + gap, h4 = SCR_H - y4 - 8;

  if (menuOpen && !bgReady) { freezeDashboard(); return; }
  if (menuOpen && bgReady) { drawMenuFrame(s); return; }

  for (int y = 0; y < SCR_H; y += STRIP_H) {
    pollTouch();                                 // between strips: keeps touch responsive at ~13 fps
    g.oy = y;
    canvas.fillSprite(C_BG);
    drawHeader(fps, s.pw.rssi);
    drawScope(s, y1, h1);
    drawDials(s, y2, h2);
    drawLinear(s, y3, h3);
    drawPower(s, y4, h4);
    canvas.pushSprite(0, y);
  }
}

// The backlight is linear PWM, but the eye is not: equal duty steps look wildly uneven. Squaring the logical
// level spreads the slider evenly across what you see; the offset keeps the lowest setting readable.
static uint8_t backlightDuty(uint8_t lvl) {
  if (lvl == 0) return 0;
  float x = lvl / 255.0f;
  return (uint8_t)(8.0f + 247.0f * x * x + 0.5f);
}

static void drawTask(void *) {
  Serial.printf("gfx task on core %d\n", xPortGetCoreID());
  static Snap snap;                              // private copy (too big for the task stack)
  uint32_t fpsT = millis(); int frames = 0, fps = 0;
  for (;;) {
    if (briWant >= 0 || scrWant >= 0) {
      uint32_t t0 = millis();
      if (briWant >= 0) { briLevel = briWant; briWant = -1; }
      if (scrWant >= 0) { scrOn = scrWant; scrWant = -1; if (!scrOn) menuClose(); }
      M5.Display.setBrightness(scrOn ? backlightDuty(briLevel) : 0);
      Serial.printf("display apply: screen=%d level=%d duty=%d (read back %d) took %u ms\n", (int)scrOn, (int)briLevel,
                    (int)backlightDuty(briLevel), (int)M5.Display.getBrightness(), (unsigned)(millis() - t0));
    }
    pollTouch();
    menuP = menuOpen ? fminf(1.0f, menuP + 0.34f) : fmaxf(0.0f, menuP - 0.34f);
    if (!scrOn) { vTaskDelay(pdMS_TO_TICKS(25)); continue; }      // backlight off: skip drawing, keep polling touch
    if (menuOpen && bgReady && menuP >= 1.0f) {                   // panel fully open: redraw only when something changed
      uint32_t nowm = millis();
      if (!menuDirty && nowm - menuTick < 1000) { vTaskDelay(pdMS_TO_TICKS(15)); continue; }
      menuDirty = false; menuTick = nowm;
    }

    xSemaphoreTake(mtx, portMAX_DELAY);
    memcpy(&snap, &live, sizeof snap);
    xSemaphoreGive(mtx);

    draw(snap, fps);

    frames++;
    uint32_t now = millis();
    if (now - fpsT >= 1000) {
      fps = frames * 1000 / (now - fpsT); frames = 0; fpsT = now; gfxFps = fps;
      Serial.printf("gfx %d fps\n", fps);
    }
    vTaskDelay(1);                               // let the idle task run
  }
}

// ---------- sampling ----------
// Fixed 100 Hz, never touches the network. Every 2nd sample is queued for transmit (50 Hz).
static void sampleTask(void *) {
  Serial.printf("sample task on core %d\n", xPortGetCoreID());
  float roll = 0, pitch = 0, yaw = 0, grav[3] = {0, 0, 0};
  bool first = true;
  TickType_t last = xTaskGetTickCount();
  uint32_t prevUs = micros(), tick = 0;
  for (;;) {
    uint32_t nowUs = micros();
    float dt = (nowUs - prevUs) * 1e-6f;
    prevUs = nowUs;

    float a[3], g[3];
    xSemaphoreTake(i2cMtx, portMAX_DELAY);
    M5.Imu.update();
    xSemaphoreGive(i2cMtx);
    M5.Imu.getAccel(&a[0], &a[1], &a[2]);
    M5.Imu.getGyro(&g[0], &g[1], &g[2]);
    orientation(a[0], a[1], a[2], g[0], g[1], g[2], dt, roll, pitch, yaw);

    float lin[3];
    for (int i = 0; i < 3; i++) {                // gravity = ~0.5 s low-pass of accel
      if (first) grav[i] = a[i];
      grav[i] += 0.02f * (a[i] - grav[i]);
      lin[i] = a[i] - grav[i];
    }
    first = false;

    xSemaphoreTake(mtx, portMAX_DELAY);
    for (int i = 0; i < 3; i++) {
      live.a[i] = a[i]; live.g[i] = g[i];
      live.accHist[i][live.head] = a[i];
      live.linHist[i][live.head] = lin[i];
    }
    live.roll = roll * RAD_TO_DEG; live.pitch = pitch * RAD_TO_DEG; live.yaw = yaw * RAD_TO_DEG;
    live.head = (live.head + 1) % HIST;
    xSemaphoreGive(mtx);

    if ((++tick & 1) == 0) {
      Sample m = {millis(), a[0], a[1], a[2], g[0], g[1], g[2],
                 (float)(roll * RAD_TO_DEG), (float)(pitch * RAD_TO_DEG), (float)(yaw * RAD_TO_DEG)};
      xQueueSend(sampleQ, &m, 0);                // drop if the tx task is behind
    }
    vTaskDelayUntil(&last, pdMS_TO_TICKS(10));
  }
}

// ---------- power / environment ----------
// 10 Hz. The INA226 sits on the battery path (2S pack), so this is battery power, not total system draw:
// on USB it shows charge current, on battery it shows the discharge of everything the tablet runs.
static void powerTask(void *) {
  Serial.printf("power task on core %d\n", xPortGetCoreID());
  TickType_t last = xTaskGetTickCount();
  float tChip = 0, tImu = 0;
  int rssi = 0; uint32_t heap = 0, tick = 0;
  float pAvg = 0; bool avgInit = false, rssiOk = true;
  for (;;) {
    PowerS p = {};
    p.t = millis();
    xSemaphoreTake(i2cMtx, portMAX_DELAY);
    p.v   = M5.Power.getBatteryVoltage() / 1000.0f;
    p.i   = M5.Power.getBatteryCurrent() / 1000.0f;
    if ((tick % 10) == 0) { float t; if (M5.Imu.getTemp(&t)) tImu = t; }
    auto cs = M5.Power.getChargeState();
    xSemaphoreGive(i2cMtx);
    p.p   = p.v * p.i;
    p.soc = (float)M5.Power.getBatteryLevel();
    p.chg = cs == m5::charge_state_t::charging ? 1
          : cs == m5::charge_state_t::discharging ? -1 : 0;

    if ((tick % 10) == 0) {                       // 1 Hz extras
      tChip = temperatureRead();
      heap  = ESP.getFreeHeap();
      if (millis() - txBeat > TX_HANG_MS) recoveryRestart("tx task stopped responding");
      if ((tick % 100) == 50) memLine("mem");     // every 10 s
    }
    // WiFi.RSSI() is an RPC to the C6 Wi-Fi coprocessor. When that RPC times out it blocks the caller for 5 s and
    // leaks memory every time, which starved the TLS link. So: ask rarely, and stop for good after one failure.
    if (rssiOk && (tick % 100) == 0 && WiFi.status() == WL_CONNECTED) {
      int r = WiFi.RSSI();
      if (r == 0) { rssiOk = false; Serial.println("rssi unavailable, not asking again"); }
      rssi = r;
    }
    p.tImu = tImu; p.tChip = tChip; p.rssi = rssi; p.heap = heap; p.mic = micOn ? micLevel : -99.0f;
    if (!avgInit) { pAvg = p.p; avgInit = true; }
    pAvg += 0.01f * (p.p - pAvg);                    // 10 Hz, ~10 s time constant
    p.avg = pAvg; p.bri = briLevel; p.scr = scrOn;
    p.wh  = BAT_WH * p.soc / 100.0f;
    p.eta = pAvg < -ETA_MIN_W ? p.wh / -pAvg * 60.0f
          : pAvg >  ETA_MIN_W ? (BAT_WH - p.wh) / pAvg * 60.0f : -1.0f;   // charge taper makes "to full" optimistic

    xSemaphoreTake(mtx, portMAX_DELAY);
    live.pw = p;
    live.pHist[live.pHead] = p.p;
    live.pHead = (live.pHead + 1) % PHIST;
    xSemaphoreGive(mtx);
    xQueueSend(powerQ, &p, 0);

    tick++;
    vTaskDelayUntil(&last, pdMS_TO_TICKS(100));
  }
}

// ---------- microphone ----------
// Off by default. "mic on" / "mic off" on tab5/cmd starts/stops capture; while on, 32 ms PCM blocks go
// to tab5/audio. The port is only opened while streaming.
static float micDbfs(const int16_t *b, int n) {       // RMS of the block, dB re full scale
  float mean = 0; for (int i = 0; i < n; i++) mean += b[i]; mean /= n;   // drop DC
  float acc = 0;  for (int i = 0; i < n; i++) { float d = b[i] - mean; acc += d * d; }
  float rms = sqrtf(acc / n);
  return rms < 1.0f ? -99.0f : 20.0f * log10f(rms / 32768.0f);
}

static void micTask(void *) {
  Serial.printf("mic task on core %d\n", xPortGetCoreID());
  static AudioChunk buf[3];                       // one being captured, one queued, one spare
  int slot = 0;
  for (;;) {
    if (!micWant) {
      if (micOn) { M5.Mic.end(); micOn = false; micLevel = -99; Serial.println("mic off"); }
      vTaskDelay(pdMS_TO_TICKS(50));
      continue;
    }
    if (!micOn) {
      M5.Speaker.end();                           // codec/I2S is shared with the speaker path
      M5.Mic.config([]{ auto c = M5.Mic.config(); c.sample_rate = MIC_RATE; c.stereo = false; return c; }());
      if (!M5.Mic.begin()) { Serial.println("mic begin failed"); micWant = false; continue; }
      micOn = true; slot = 0;
      Serial.println("mic on");
      M5.Mic.record(buf[0].pcm, MIC_N, MIC_RATE);
    }
    // Block until the pending buffer is filled, arm the next one, then hand the filled one on.
    int cur = slot; slot = (slot + 1) % 3;
    M5.Mic.record(buf[slot].pcm, MIC_N, MIC_RATE);     // queue next (2 request slots)
    while (M5.Mic.isRecording() > 1 && micWant) vTaskDelay(1);   // wait until `cur` is complete
    micLevel = micDbfs(buf[cur].pcm, MIC_N);
    xQueueSend(audioQ, &buf[cur], 0);              // copies; dropped if the tx task is behind
  }
}

// ---------- networking (txTask only) ----------
static uint32_t lastMqttTry, lastWifiTry, pubCount, rateT, lastOnline;
static int failStreak;


static void netService() {
  uint32_t now = millis();
  wifiUp = WiFi.status() == WL_CONNECTED;
  if (wifiUp) wifiDownSince = 0;
  else { if (!wifiDownSince) wifiDownSince = now | 1; mqttDownSince = 0; }
  if (!wifiUp) {
    if (now - lastWifiTry > 10000 || lastWifiTry == 0) { lastWifiTry = now ? now : 1; WiFi.begin(WIFI_SSID, WIFI_PASS); }
    return;
  }
  // Certificate validity dates are checked, so the clock must be set first (NTP; needs internet).
  static bool ntpStarted = false;
  if (time(nullptr) < 1700000000) {
    if (!ntpStarted) { configTime(0, 0, "pool.ntp.org", "time.google.com"); ntpStarted = true; }
    return;
  }
  if (!mqtt.connected()) {
    if (now - lastMqttTry > 3000) {
      lastMqttTry = now;
      String id = "tab5-" + String((uint32_t)ESP.getEfuseMac(), HEX);
      if (mqtt.connect(id.c_str(), MQTT_USER, MQTT_PASS)) {
        mqtt.subscribe(MQTT_TOPIC_CMD);
        if (failStreak) Serial.printf("mqtt connected again after %d failed attempts\n", failStreak);
        failStreak = 0; wdRestarts = 0;
      } else {
        char err[96] = "";
        wifiClient.lastError(err, sizeof err);
        Serial.printf("mqtt connect failed: state=%d tls='%s'\n", mqtt.state(), err);
        memLine("mem");
        // A dead broker also fails every attempt, so do not bounce Wi-Fi more than once a minute.
        static uint32_t lastReset;
        if (++failStreak >= WIFI_RESET_EVERY && now - lastReset > 60000) {
          lastReset = now;
          Serial.printf("RECOVERY resetting Wi-Fi after %d failed connects\n", failStreak);
          wifiClient.stop();
          WiFi.disconnect();
          lastWifiTry = 0;                    // reconnect on the next pass
        }
      }
    }
    return;
  }
  mqtt.loop();
}

static void publish(const Sample &m) {
  char p[192];
  int n = snprintf(p, sizeof p,
    "{\"t\":%lu,\"ax\":%.4f,\"ay\":%.4f,\"az\":%.4f,\"gx\":%.3f,\"gy\":%.3f,\"gz\":%.3f,"
    "\"roll\":%.2f,\"pitch\":%.2f,\"yaw\":%.2f}",
    (unsigned long)m.t, m.ax, m.ay, m.az, m.gx, m.gy, m.gz, m.roll, m.pitch, m.yaw);
  if (n > 0 && mqtt.publish(MQTT_TOPIC, p)) { pubCount++; pubTotal++; }
}

static void onMessage(char *topic, uint8_t *pl, unsigned len) {
  if (strcmp(topic, MQTT_TOPIC_CMD) != 0) return;
  char c[24] = {}; memcpy(c, pl, len < sizeof c - 1 ? len : sizeof c - 1);
  if (!strcmp(c, "mic on"))     micWant = true;
  if (!strcmp(c, "mic off"))    micWant = false;
  if (!strcmp(c, "screen on"))  scrWant = 1;
  if (!strcmp(c, "screen off")) scrWant = 0;
  int b;
  if (sscanf(c, "brightness %d", &b) == 1) briWant = b < 0 ? 0 : b > 255 ? 255 : b;
}

static void publishPower(const PowerS &p) {
  char b[320];
  int n = snprintf(b, sizeof b,
    "{\"t\":%lu,\"v\":%.3f,\"i\":%.4f,\"p\":%.3f,\"soc\":%.0f,\"chg\":%d,"
    "\"t_imu\":%.1f,\"t_chip\":%.1f,\"rssi\":%d,\"heap\":%lu,\"mic\":%.1f,"
    "\"avg\":%.3f,\"wh\":%.2f,\"eta\":%.0f,\"scr\":%d,\"bri\":%d}",
    (unsigned long)p.t, p.v, p.i, p.p, p.soc, p.chg, p.tImu, p.tChip, p.rssi, (unsigned long)p.heap, p.mic,
    p.avg, p.wh, p.eta, p.scr, p.bri);
  if (n > 0 && mqtt.publish(MQTT_TOPIC_POWER, b)) pubTotal++;
}

// A slow connect only delays this task; samples are dropped, not backlogged.
static void txTask(void *) {
  Serial.printf("mqtt task on core %d\n", xPortGetCoreID());
  Sample m;
  uint32_t lastIter = millis();
  lastOnline = lastIter; txBeat = lastIter;
  for (;;) {
    uint32_t it = millis();
    if (it - lastIter > 500) Serial.printf("tx stall %u ms (wifi=%d mqtt=%d heap=%u largest=%u)\n", (unsigned)(it - lastIter), (int)wifiUp, (int)mqttUp,
                                           (unsigned)ESP.getFreeHeap(), (unsigned)heap_caps_get_largest_free_block(MALLOC_CAP_INTERNAL));
    lastIter = it;
    txBeat = it;
    netService();
    mqttUp = mqtt.connected();
    if (mqttUp) mqttDownSince = 0; else if (wifiUp && !mqttDownSince) mqttDownSince = millis() | 1;
    if (mqttUp) lastOnline = millis();
    else if (millis() - lastOnline > OFFLINE_RESTART_MS) recoveryRestart("no MQTT link");
    if (xQueueReceive(sampleQ, &m, pdMS_TO_TICKS(10)) == pdTRUE && mqttUp) publish(m);
    PowerS pw;
    while (xQueueReceive(powerQ, &pw, 0) == pdTRUE) if (mqttUp) publishPower(pw);
    static AudioChunk ac;
    while (xQueueReceive(audioQ, &ac, 0) == pdTRUE) if (mqttUp && mqtt.publish(MQTT_TOPIC_AUDIO, (const uint8_t *)ac.pcm, sizeof ac.pcm)) pubTotal++;
    uint32_t now = millis();
    if (now - rateT >= 1000) { rateT = now; pubRate = pubCount; pubCount = 0; Serial.printf("pub=%u/s\n", (unsigned)pubRate); }
  }
}

// ---------- setup ----------
void setup() {
  auto cfg = M5.config();
  M5.begin(cfg);
  M5.Display.setRotation(0);                       // native portrait 720x1280
  briLevel = 180;                                  // logical level (~70%); the backlight duty is derived from it
  M5.Display.setBrightness(backlightDuty(briLevel));
  canvas.setColorDepth(lgfx::rgb565_nonswapped);   // match the DSI panel's native format
  canvas.setPsram(false);                          // internal RAM: ~10x faster fills than PSRAM
  if (!canvas.createSprite(SCR_W, STRIP_H)) Serial.println("strip sprite alloc failed");
  bgCache = (uint16_t *)heap_caps_malloc((size_t)CACHE_STRIPS * SCR_W * STRIP_H * 2, MALLOC_CAP_SPIRAM);
  if (!bgCache) Serial.println("panel cache alloc failed");
  canvas.setTextDatum(top_left);

  Serial.begin(115200);
  if (wdMagic != WD_MAGIC) { wdMagic = WD_MAGIC; wdRestarts = 0; }     // RTC_NOINIT memory is garbage after power-on
  if (esp_reset_reason() == ESP_RST_POWERON) wdRestarts = 0;
  Serial.printf("boot: reset reason %d, recovery restarts so far %u, strip %d px\n", (int)esp_reset_reason(), (unsigned)wdRestarts, STRIP_H);
  if (!M5.Imu.isEnabled()) Serial.println("IMU not found");

  WiFi.mode(WIFI_STA);
  wifiClient.setCACert(CA_CERT);
  wifiClient.setHandshakeTimeout(10);
  mqtt.setServer(MQTT_HOST, MQTT_PORT);
  mqtt.setBufferSize(MIC_N * 2 + 64);    // must hold one audio block + topic
  mqtt.setCallback(onMessage);


  mtx = xSemaphoreCreateMutex();
  sampleQ = xQueueCreate(64, sizeof(Sample));
  powerQ  = xQueueCreate(16, sizeof(PowerS));
  audioQ  = xQueueCreate(6, sizeof(AudioChunk));
  i2cMtx  = xSemaphoreCreateMutex();

  // Core 0: graphics. Core 1: sampling (higher prio) and MQTT transmit.
  xTaskCreatePinnedToCore(drawTask,   "gfx",    12288, nullptr, 1, nullptr, CORE_GFX);
  xTaskCreatePinnedToCore(sampleTask, "sample", 6144,  nullptr, 3, nullptr, CORE_IO);
  xTaskCreatePinnedToCore(txTask,     "mqtt",   8192,  nullptr, 2, nullptr, CORE_IO);
  xTaskCreatePinnedToCore(powerTask,  "power",  6144,  nullptr, 2, nullptr, CORE_IO);
  xTaskCreatePinnedToCore(micTask,    "mic",    6144,  nullptr, 2, nullptr, CORE_IO);
}

void loop() { vTaskDelete(nullptr); }              // all work lives in the pinned tasks
